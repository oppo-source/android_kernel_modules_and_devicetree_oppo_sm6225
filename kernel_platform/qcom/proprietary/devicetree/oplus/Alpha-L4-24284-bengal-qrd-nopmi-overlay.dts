/dts-v1/;
/plugin/;

#include "../qcom/bengal-qrd-nopmi-overlay.dts"
#include "Alpha-L4_overlay_common.dtsi"
#include "oplus_chg/oplus-chg-24284.dtsi"
#include "oplus_chg/oplus-chg-24281-24282-24283-24284-pps.dtsi"
#include "nfc/alphal4-nfc-pn560_24284.dtsi"

/ {
    model = "Qualcomm Technologies, Inc. BENGAL QRD nopmi overlay, Alpha-L4";
    oplus,dtsi_no = <24284>;
    oplus,project-id = <24284>;
};
