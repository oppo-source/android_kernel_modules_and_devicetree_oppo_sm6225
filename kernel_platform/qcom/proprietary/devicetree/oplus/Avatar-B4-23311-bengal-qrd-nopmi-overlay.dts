/dts-v1/;
/plugin/;

#include "../qcom/bengal-qrd-nopmi-overlay.dts"
#include "Avatar-B4_overlay_common.dtsi"
#include "oplus_chg/oplus-chg-23311-23312-23313.dtsi"
#include "nfc/avatarB4-nfc-pn560.dtsi"
#include "sensor/Avatar-B4-23311-sensor-mtp.dtsi"


/ {
    model = "Qualcomm Technologies, Inc. BENGAL QRD nopmi overlay, Avatar-B4 export";
    oplus,dtsi_no = <23311 23313 23314 23316 23318 23319>;
    oplus,project-id = <23311 23313 23314 23316 23318 23319>;
};
