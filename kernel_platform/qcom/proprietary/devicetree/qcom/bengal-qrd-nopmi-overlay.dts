/dts-v1/;
/plugin/;

#include <dt-bindings/interrupt-controller/arm-gic.h>
#include "bengal-qrd-nopmi.dtsi"

/ {
	model = "Qualcomm Technologies, Inc. BENGAL QRD nopmi";
	compatible = "qcom,bengal-qrd", "qcom,bengal", "qcom,qrd";
	qcom,msm-id = <417 0x10000>, <444 0x10000>;
	qcom,board-id = <0x1000B 0>;
	qcom,pmic-id = <0x2D 0x0 0x0 0x0>;
};
