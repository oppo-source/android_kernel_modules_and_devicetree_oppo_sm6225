/dts-v1/;
/plugin/;

#include "bengal-audio-overlay.dtsi"
/ {
	model = "Qualcomm Technologies, Inc. BENGAL IDP";
	compatible = "qcom,bengal";
	qcom,msm-id = <417 0x10000>, <444 0x10000>;
	qcom,board-id = <34 0>;
	qcom,pmic-id = <0x2D 0x25 0x0 0x0>;
};

