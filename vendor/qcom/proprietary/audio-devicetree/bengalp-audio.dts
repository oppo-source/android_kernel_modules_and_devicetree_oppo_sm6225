/dts-v1/;
/plugin/;

#include <dt-bindings/clock/qcom,gcc-sm6115.h>
#include <dt-bindings/clock/qcom,sm6115-gpucc.h>
#include <dt-bindings/interrupt-controller/arm-gic.h>
#include <dt-bindings/interconnect/qcom,bengal.h>
#include "bengal-audio.dtsi"
/ {
	model = "Qualcomm Technologies, Inc. Bengalp SoC";
	compatible = "qcom,bengalp";
	qcom,msm-id = <445 0x10000>, <420 0x10000>;
	qcom,board-id = <0 0>;
};
