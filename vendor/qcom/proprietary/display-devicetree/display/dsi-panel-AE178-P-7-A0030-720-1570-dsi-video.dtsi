&mdss_mdp {
	dsi_AE178_P_7_A0030_video: qcom,mdss_dsi_AE178_P_7_A0030_video {
		qcom,mdss-dsi-panel-name =
				"AE178 p 7 A0030 video mode panel";
		qcom,mdss-dsi-panel-type = "dsi_video_mode";
		oplus,mdss-dsi-vendor-name = "A0030";
		oplus,mdss-dsi-manufacture = "P_7";
		qcom,dsi-ctrl-num = <0>;
		qcom,dsi-phy-num = <0>;
		qcom,mdss-dsi-virtual-channel-id = <0>;
		qcom,mdss-dsi-stream = <0>;
		qcom,mdss-dsi-h-left-border = <0>;
		qcom,mdss-dsi-h-right-border = <0>;
		qcom,mdss-dsi-v-top-border = <0>;
		qcom,mdss-dsi-v-bottom-border = <0>;
		qcom,mdss-dsi-bpp = <24>;
		qcom,mdss-dsi-color-order = "rgb_swap_rgb";
		qcom,mdss-dsi-underflow-color = <0xff>;
		qcom,mdss-dsi-border-color = <0>;
		qcom,mdss-dsi-h-sync-pulse = <0>;
		qcom,mdss-dsi-traffic-mode = "non_burst_sync_event";
		qcom,mdss-dsi-lane-map = "lane_map_0123";
		qcom,mdss-dsi-bllp-eof-power-mode;
		qcom,mdss-dsi-bllp-power-mode;
		qcom,mdss-dsi-tx-eot-append;
		qcom,mdss-dsi-lane-0-state;
		qcom,mdss-dsi-lane-1-state;
		qcom,mdss-dsi-lane-2-state;
		qcom,mdss-dsi-lane-3-state;
		qcom,mdss-dsi-dma-trigger = "trigger_sw";
		qcom,mdss-dsi-mdp-trigger = "none";
		qcom,mdss-dsi-lp11-init;
		qcom,platform-reset-gpio-always-on;
		qcom,mdss-dsi-bl-inverted-dbv;
		qcom,mdss-dsi-reset-sequence = <1 10>, <0 10>, <1 10>;
		qcom,mdss-pan-physical-width-dimension = <69>;
		qcom,mdss-pan-physical-height-dimension = <155>;
		qcom,mdss-dsi-display-timings {
			timing@0 {
				qcom,mdss-dsi-panel-width = <720>;
				qcom,mdss-dsi-panel-height = <1570>;
				qcom,mdss-dsi-h-front-porch = <16>;
				qcom,mdss-dsi-h-back-porch = <16>;
				qcom,mdss-dsi-h-pulse-width = <12>;
				qcom,mdss-dsi-h-sync-skew = <0>;
				qcom,mdss-dsi-v-back-porch = <20>;
				qcom,mdss-dsi-v-front-porch = <360>;
				qcom,mdss-dsi-v-pulse-width = <4>;
				qcom,mdss-dsi-panel-framerate = <144>;
				qcom,mdss-dsi-on-command = [
					39 01 00 00 00 00 04 FF 5A A5 06
					15 01 00 00 00 00 02 3E 62
					15 01 00 00 00 00 02 D6 50
					15 01 00 00 00 00 02 07 A4
					39 01 00 00 00 00 04 FF 5A A5 01
					15 01 00 00 00 00 02 D1 01
					15 01 00 00 00 00 02 D8 15
					15 01 00 00 00 00 02 D9 15
					15 01 00 00 00 00 02 DA 10
					15 01 00 00 00 00 02 DB 04
					15 01 00 00 00 00 02 E1 D5
					15 01 00 00 00 00 02 E2 41
					39 01 00 00 00 00 04 FF 5A A5 02
					15 01 00 00 00 00 02 1B 10
					39 01 00 00 00 00 04 FF 5A A5 03
					15 01 00 00 00 00 02 83 20
					15 01 00 00 00 00 02 84 01
					15 01 00 00 00 00 02 BB BC

					15 01 00 00 00 00 02 80 26
					15 01 00 00 00 00 02 81 26
					15 01 00 00 00 00 02 82 26

					15 01 00 00 00 00 02 88 FF
					15 01 00 00 00 00 02 89 FF
					15 01 00 00 00 00 02 8A FF
					15 01 00 00 00 00 02 8B FF
					15 01 00 00 00 00 02 A6 FF
					15 01 00 00 00 00 02 AC FF

					15 01 00 00 00 00 02 8C FF
					15 01 00 00 00 00 02 8D FF
					15 01 00 00 00 00 02 8E FF
					15 01 00 00 00 00 02 8F FF
					15 01 00 00 00 00 02 90 FF
					15 01 00 00 00 00 02 91 FF
					15 01 00 00 00 00 02 92 FF
					15 01 00 00 00 00 02 93 FF
					15 01 00 00 00 00 02 94 FF
					15 01 00 00 00 00 02 95 FF
					15 01 00 00 00 00 02 A7 FF
					15 01 00 00 00 00 02 AD FF
					15 01 00 00 00 00 02 A9 FF
					15 01 00 00 00 00 02 B3 FF

					15 01 00 00 00 00 02 A8 F0
					15 01 00 00 00 00 02 AE D5
					15 01 00 00 00 00 02 96 60
					15 01 00 00 00 00 02 97 9B
					15 01 00 00 00 00 02 98 9C
					15 01 00 00 00 00 02 99 9F
					15 01 00 00 00 00 02 9A C6
					15 01 00 00 00 00 02 9B D5
					15 01 00 00 00 00 02 9C D5
					15 01 00 00 00 00 02 9D D5
					15 01 00 00 00 00 02 9E D5
					15 01 00 00 00 00 02 9F D5
					15 01 00 00 00 00 02 B5 D3
					15 01 00 00 00 00 02 B6 84
					15 01 00 00 00 00 02 B7 84
					15 01 00 00 00 00 02 B8 84
					15 01 00 00 00 00 02 C6 50
					15 01 00 00 00 00 02 FB C1

					39 01 00 00 00 00 04 FF 5A A5 12
					15 01 00 00 00 00 02 01 38
					15 01 00 00 00 00 02 02 00
					15 01 00 00 00 00 02 10 00
					15 01 00 00 00 00 02 11 6C
					15 01 00 00 00 00 02 12 00
					15 01 00 00 00 00 02 13 18
					15 01 00 00 00 00 02 14 01
					15 01 00 00 00 00 02 15 68
					39 01 00 00 00 00 04 FF 5A A5 0B
					15 01 00 00 00 00 02 AD 47
					15 01 00 00 00 00 02 AE 1B
					15 01 00 00 00 00 02 AF 05
					15 01 00 00 00 00 02 B0 05
					15 01 00 00 00 00 02 B1 B1
					15 01 00 00 00 00 02 B2 B1
					15 01 00 00 00 00 02 BD 22
					15 01 00 00 00 00 02 BE E0
					39 01 00 00 00 00 04 FF 5A A5 0E
					15 01 00 00 00 00 02 18 17
					15 01 00 00 00 00 02 19 09

					39 01 00 00 00 00 04 FF 5A A5 00
					15 01 00 00 00 00 02 53 2C
					39 01 00 00 00 00 03 51 00 00
					15 01 00 00 00 00 02 55 03
					15 01 00 00 00 00 02 35 00
					39 01 00 00 00 00 03 68 04 00
					15 01 00 00 42 00 02 11 00
					15 01 00 00 1F 00 02 29 00
				];
				qcom,mdss-dsi-off-command = [
					15 01 00 00 14 00 02 28 00
					15 01 00 00 78 00 02 10 00
				];
				qcom,mdss-dsi-cabc-mode1-command = [
					39 01 00 00 00 00 02 55 01
				];
				qcom,mdss-dsi-cabc-mode2-command = [
					39 01 00 00 00 00 02 55 02
				];
				qcom,mdss-dsi-cabc-mode3-command = [
					39 01 00 00 00 00 02 55 03
				];
				qcom,mdss-dsi-cabc-off-command = [
					39 01 00 00 00 00 02 55 01
				];

				/* lcd aod start */
				qcom,mdss-dsi-lp1-command = [
					39 00 00 40 00 00 02 55 00
					15 00 00 40 00 00 02 53 24
					39 00 00 00 00 00 03 51 00 D0
				];

				qcom,mdss-dsi-aod-high-mode-command = [
					/* AOD High Mode 50nit */
					15 00 00 40 00 00 02 55 00
					39 00 00 00 00 00 03 51 00 D0
				];
				qcom,mdss-dsi-aod-low-mode-command = [
					/* AOD Low Mode 10nit */
					15 00 00 40 00 00 02 55 00
					39 00 00 00 00 00 03 51 00 27
				];
				/* lcd aod end */

				qcom,mdss-dsi-nolp-command = [
					15 01 00 00 00 00 02 55 03
					15 00 00 40 00 00 02 53 2C
				];

				qcom,mdss-dsi-backlight-gamma-enter-command = [
					15 01 00 00 00 00 02 B0 00
					39 01 00 00 00 00 4D C7 02 20 02 29 02 3C 02 4E 02 6F 02 5D 02 12 01 E3 01 C0
						01 B7 01 B0 01 B1 01 BC 01 B2 01 BF 02 49 02 7B 02 E8 02 FF
						02 20 02 29 02 3C 02 4E 02 6F 02 5D 02 12 01 E3 01 C0 01 B7
						01 B0 01 B1 01 BC 01 B2 01 BF 02 49 02 7B 02 E8 02 FF
				];
				qcom,mdss-dsi-backlight-gamma-exit-command = [
					15 01 00 00 00 00 02 B0 00
					39 01 00 00 00 00 4D C7 00 6C 00 9B 00 BB 00 F7 01 50 01 7E 01 72 01 7C 01 7C
						01 87 01 8E 01 96 01 A7 01 9E 01 B0 02 37 02 6F 02 AF 02 DB
						00 24 00 42 00 AF 00 F7 01 50 01 7E 01 72 01 7C 01 7C 01 87
						01 8E 01 96 01 A7 01 9E 01 B0 02 37 02 6F 02 93 02 93
				];

				qcom,mdss-dsi-dimming-setting-command = [
					15 00 00 40 00 00 02 53 24
				];
				qcom,mdss-dsi-on-command-state = "dsi_lp_mode";
				qcom,mdss-dsi-off-command-state = "dsi_lp_mode";
				qcom,mdss-dsi-cabc-mode1-command-state = "dsi_hs_mode";
				qcom,mdss-dsi-cabc-mode2-command-state = "dsi_hs_mode";
				qcom,mdss-dsi-cabc-mode3-command-state = "dsi_hs_mode";
				qcom,mdss-dsi-cabc-off-command-state = "dsi_hs_mode";
				qcom,mdss-dsi-lp1-command-state = "dsi_hs_mode";
				qcom,mdss-dsi-aod-high-mode-command-state = "dsi_hs_mode";
				qcom,mdss-dsi-aod-low-mode-command-state = "dsi_hs_mode";
				qcom,mdss-dsi-nolp-command-state = "dsi_hs_mode";
				qcom,mdss-dsi-backlight-gamma-enter-command-state = "dsi_hs_mode";
				qcom,mdss-dsi-backlight-gamma-exit-command-state = "dsi_hs_mode";
				qcom,mdss-dsi-dimming-setting-command-state = "dsi_hs_mode";
			};
		};
	};
};

&dsi_AE178_P_7_A0030_video {
	qcom,panel-supply-entries = <&dsi_panel_pwr_supply_no_labibb>;
	qcom,mdss-dsi-bl-pmic-control-type = "bl_ctrl_dcs";
	qcom,bl-pmic-pwm-period-usecs = <100>;
	qcom,bl-update-flag = "delay_until_first_frame";
	qcom,mdss-dsi-bl-min-level = <8>;
	qcom,mdss-dsi-bl-max-level = <4095>;
	qcom,mdss-brightness-max-level = <4095>;
	oplus,dsi-bl-normal-max-level = <3319>;
	oplus,dsi-brightness-normal-max-level = <3319>;
	oplus,dsi-brightness-default-level = <495>;
	qcom,platform-te-gpio = <&tlmm 81 0>;
	qcom,platform-reset-gpio = <&tlmm 82 0>;
	qcom,platform-panel-P5V-gpio = <&tlmm 103 0>;
	qcom,platform-panel-N5V-gpio = <&tlmm 101 0>;
	qcom,platform-panel-vddi-gpio = <&tlmm 105 0>;
	oplus,mdss-dsi-vspn-voltage = <6000>;

	/* ofp config*/
	oplus,ofp-fp-type = <0x02>;

	/* gamma switch */
	oplus,mdss-dsi-gamma-switch-enabled;

	qcom,mdss-dsi-t-clk-post = <0x0E>;
	qcom,mdss-dsi-t-clk-pre = <0x1D>;

	/* esd config */
	qcom,esd-check-enabled;
	qcom,mdss-dsi-panel-status-check-mode = "reg_read";
	qcom,mdss-dsi-panel-status-command = [06 01 00 01 00 00 01 09];
	qcom,mdss-dsi-panel-status-command-state = "dsi_lp_mode";
	qcom,mdss-dsi-panel-status-value = <0x80 0x03 0x06>;
	qcom,mdss-dsi-panel-status-read-length = <3>;
	oplus,mdss-dsi-panel-status-match-modes = <0x00000000>;

	/* oplus feature config */
	oplus,dsi-cabc-enabled;

	/* Dimming Setting config*/
	oplus,dsi-dimming-setting-before-bl-0-enable;

	/* dynamic fps config */
	qcom,mdss-dsi-pan-enable-dynamic-fps;
	qcom,dsi-supported-dfps-list = <144 120 90 60>;
	qcom,mdss-dsi-pan-fps-update = "dfps_immediate_porch_mode_vfp";
	qcom,mdss-dsi-min-refresh-rate = <60>;
	qcom,mdss-dsi-max-refresh-rate = <144>;
	//oplus,dfps-idle-off;

	qcom,dsi-dyn-clk-enable;

	qcom,dsi-select-clocks = "pll_byte_clk0", "pll_dsi_clk0";
	qcom,mdss-dsi-display-timings {
		timing@0 {
			qcom,mdss-dsi-panel-phy-timings = [00 2A 0B 0B 1C 1A 0B
					0C 0C 0B 02 04 23 23];
			qcom,display-topology = <1 0 1>;
			qcom,default-topology-index = <0>;
			qcom,dsi-dyn-clk-list =
				<1289387520 1297446192>;
		};
	};
};
