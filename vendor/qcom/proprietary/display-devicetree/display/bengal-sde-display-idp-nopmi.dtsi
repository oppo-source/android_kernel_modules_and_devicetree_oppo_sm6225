#include "bengal-sde-display-idp.dtsi"

&dsi_td4330_truly_v2_video {
	 /delete-property/ qcom,esd-check-enabled;
};

&dsi_td4330_truly_v2_cmd {
	 /delete-property/ qcom,esd-check-enabled;
};

&dsi_panel_td4160_hx_alpha_b4_video {
	/delete-property/ qcom,platform-bklight-en-gpio;
};

&dsi_panel_ili9883c_boe_alpha_b4_video {
	/delete-property/ qcom,platform-bklight-en-gpio;
};
