/dts-v1/;
/plugin/;

#include "baikal-b4-25258-sde-display-khaje-overlay.dtsi"

/ {
	oplus,project-id = <25251 25252 25253 25250 25246 25257 25255 25248 25258 25259 25031 25249 25310 25245 25244 25243 25260 25311 25270 25280 25290 25300 25891 25032>;
};
