&mdss_mdp {
	dsi_AE178_P_3_A0030_video: qcom,mdss_dsi_AE178_P_3_A0030_video {
		qcom,mdss-dsi-panel-name =
				"AE178 p 3 A0030 video mode panel";
		qcom,mdss-dsi-panel-type = "dsi_video_mode";
		oplus,mdss-dsi-vendor-name = "A0030";
		oplus,mdss-dsi-manufacture = "P_3";
		qcom,dsi-ctrl-num = <0>;
		qcom,dsi-phy-num = <0>;
		qcom,mdss-dsi-virtual-channel-id = <0>;
		qcom,mdss-dsi-stream = <0>;
		qcom,mdss-dsi-h-left-border = <0>;
		qcom,mdss-dsi-h-right-border = <0>;
		qcom,mdss-dsi-v-top-border = <0>;
		qcom,mdss-dsi-v-bottom-border = <0>;
		qcom,mdss-dsi-bpp = <24>;
		qcom,mdss-dsi-color-order = "rgb_swap_rgb";
		qcom,mdss-dsi-underflow-color = <0xff>;
		qcom,mdss-dsi-border-color = <0>;
		qcom,mdss-dsi-h-sync-pulse = <0>;
		qcom,mdss-dsi-traffic-mode = "non_burst_sync_event";
		qcom,mdss-dsi-lane-map = "lane_map_0123";
		qcom,mdss-dsi-bllp-eof-power-mode;
		qcom,mdss-dsi-bllp-power-mode;
		qcom,mdss-dsi-tx-eot-append;
		qcom,mdss-dsi-lane-0-state;
		qcom,mdss-dsi-lane-1-state;
		qcom,mdss-dsi-lane-2-state;
		qcom,mdss-dsi-lane-3-state;
		qcom,mdss-dsi-dma-trigger = "trigger_sw";
		qcom,mdss-dsi-mdp-trigger = "none";
		qcom,mdss-dsi-bl-inverted-dbv;
		qcom,mdss-dsi-reset-sequence = <1 10>, <0 10>, <1 10>;
		qcom,mdss-pan-physical-width-dimension = <69>;
		qcom,mdss-pan-physical-height-dimension = <155>;
		qcom,mdss-dsi-display-timings {
			timing@0 {
				qcom,mdss-dsi-panel-width = <720>;
				qcom,mdss-dsi-panel-height = <1570>;
				qcom,mdss-dsi-h-front-porch = <20>;
				qcom,mdss-dsi-h-back-porch = <20>;
				qcom,mdss-dsi-h-pulse-width = <10>;
				qcom,mdss-dsi-h-sync-skew = <0>;
				qcom,mdss-dsi-v-back-porch = <20>;
				qcom,mdss-dsi-v-front-porch = <310>;
				qcom,mdss-dsi-v-pulse-width = <4>;
				qcom,mdss-dsi-panel-framerate = <120>;
				qcom,mdss-dsi-on-command = [
					39 01 00 00 00 00 04 FF 5A A5 06
					15 01 00 00 00 00 02 07 A4
					39 01 00 00 00 00 04 FF 5A A5 03
					15 01 00 00 00 00 02 83 20          //PWM 12bit
					15 01 00 00 00 00 02 84 00
					39 01 00 00 00 00 04 FF 5A A5 00
					15 01 00 00 00 00 02 53 2C            //enable pwm
					39 01 00 00 00 00 03 51 FF FF
					15 01 00 00 00 00 02 35 00
					39 01 00 00 00 00 03 68 03 00
					15 01 00 00 42 00 02 11 00
					15 01 00 00 1F 00 02 29 00
				];
				qcom,mdss-dsi-off-command = [
					15 01 00 00 14 00 02 28 00
					15 01 00 00 78 00 02 10 00
				];
				qcom,mdss-dsi-cabc-mode1-command = [
					39 01 00 00 00 00 02 55 01
				];
				qcom,mdss-dsi-cabc-mode2-command = [
					39 01 00 00 00 00 02 55 02
				];
				qcom,mdss-dsi-cabc-mode3-command = [
					39 01 00 00 00 00 02 55 03
				];
				qcom,mdss-dsi-cabc-off-command = [
					39 01 00 00 00 00 02 55 00
				];

				qcom,mdss-dsi-backlight-gamma-enter-command = [
					15 01 00 00 00 00 02 B0 00
					39 01 00 00 00 00 4D C7 02 20 02 29 02 3C 02 4E 02 6F 02 5D 02 12 01 E3 01 C0
						01 B7 01 B0 01 B1 01 BC 01 B2 01 BF 02 49 02 7B 02 E8 02 FF
						02 20 02 29 02 3C 02 4E 02 6F 02 5D 02 12 01 E3 01 C0 01 B7
						01 B0 01 B1 01 BC 01 B2 01 BF 02 49 02 7B 02 E8 02 FF
				];
				qcom,mdss-dsi-backlight-gamma-exit-command = [
					15 01 00 00 00 00 02 B0 00
					39 01 00 00 00 00 4D C7 00 6C 00 9B 00 BB 00 F7 01 50 01 7E 01 72 01 7C 01 7C
						01 87 01 8E 01 96 01 A7 01 9E 01 B0 02 37 02 6F 02 AF 02 DB
						00 24 00 42 00 AF 00 F7 01 50 01 7E 01 72 01 7C 01 7C 01 87
						01 8E 01 96 01 A7 01 9E 01 B0 02 37 02 6F 02 93 02 93
				];
				qcom,mdss-dsi-on-command-state = "dsi_lp_mode";
				qcom,mdss-dsi-off-command-state = "dsi_lp_mode";
				qcom,mdss-dsi-cabc-mode1-command-state = "dsi_hs_mode";
				qcom,mdss-dsi-cabc-mode2-command-state = "dsi_hs_mode";
				qcom,mdss-dsi-cabc-mode3-command-state = "dsi_hs_mode";
				qcom,mdss-dsi-cabc-off-command-state = "dsi_hs_mode";
				qcom,mdss-dsi-backlight-gamma-enter-command-state = "dsi_hs_mode";
				qcom,mdss-dsi-backlight-gamma-exit-command-state = "dsi_hs_mode";
			};
		};
	};
};

&dsi_AE178_P_3_A0030_video {
	qcom,panel-supply-entries = <&dsi_panel_pwr_supply_no_labibb>;
	qcom,mdss-dsi-bl-pmic-control-type = "bl_ctrl_dcs";
	qcom,bl-pmic-pwm-period-usecs = <100>;
	qcom,bl-update-flag = "delay_until_first_frame";
	qcom,mdss-dsi-bl-min-level = <8>;
	qcom,mdss-dsi-bl-max-level = <4095>;
	qcom,mdss-brightness-max-level = <4095>;
	oplus,dsi-bl-normal-max-level = <3319>;
	oplus,dsi-brightness-normal-max-level = <3319>;
	oplus,dsi-brightness-default-level = <495>;
	qcom,platform-te-gpio = <&tlmm 81 0>;
	qcom,platform-reset-gpio = <&tlmm 82 0>;
	qcom,platform-panel-P5V-gpio = <&tlmm 103 0>;
	qcom,platform-panel-N5V-gpio = <&tlmm 101 0>;
	qcom,platform-panel-vddi-gpio = <&tlmm 105 0>;
	oplus,mdss-dsi-vspn-voltage = <6000>;

	/* gamma switch */
	oplus,mdss-dsi-gamma-switch-enabled;

	qcom,mdss-dsi-t-clk-post = <0x0E>;
	qcom,mdss-dsi-t-clk-pre = <0x1D>;

	/* esd config */
	qcom,esd-check-enabled;
	qcom,mdss-dsi-panel-status-check-mode = "reg_read";
	qcom,mdss-dsi-panel-status-command = [06 01 00 01 00 00 01 09];
	qcom,mdss-dsi-panel-status-command-state = "dsi_lp_mode";
	qcom,mdss-dsi-panel-status-value = <0x80 0x03 0x06>;
	qcom,mdss-dsi-panel-status-read-length = <3>;
	oplus,mdss-dsi-panel-status-match-modes = <0x00000000>;

	/* dynamic fps config */
	qcom,mdss-dsi-pan-enable-dynamic-fps;
	qcom,dsi-supported-dfps-list = <120 90 60>;
	qcom,mdss-dsi-pan-fps-update = "dfps_immediate_porch_mode_vfp";
	qcom,mdss-dsi-min-refresh-rate = <60>;
	qcom,mdss-dsi-max-refresh-rate = <120>;
	//oplus,dfps-idle-off;

	qcom,dsi-select-clocks = "pll_byte_clk0", "pll_dsi_clk0";
	qcom,mdss-dsi-display-timings {
		timing@0 {
			qcom,mdss-dsi-panel-phy-timings = [00 23 09 09 1A 18 09
					09 09 02 04 00 1D 21];
			qcom,display-topology = <1 0 1>;
			qcom,default-topology-index = <0>;
		};
	};
};
