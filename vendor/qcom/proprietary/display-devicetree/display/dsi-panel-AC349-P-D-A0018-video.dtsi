&mdss_mdp {
	dsi_panel_AC349_P_D_A0018_video: qcom,mdss_dsi_panel_AC349_P_D_A0018_video {
		qcom,mdss-dsi-panel-name =
				"AC349 P D A0018 video mode dsi panel";
				qcom,mdss-dsi-panel-type = "dsi_video_mode";
		oplus,mdss-dsi-vendor-name = "A0018";
		oplus,mdss-dsi-manufacture = "P_D";
		qcom,dsi-ctrl-num = <0>;
		qcom,dsi-phy-num = <0>;
		qcom,mdss-dsi-virtual-channel-id = <0>;
		qcom,mdss-dsi-stream = <0>;
		qcom,mdss-dsi-h-left-border = <0>;
		qcom,mdss-dsi-h-right-border = <0>;
		qcom,mdss-dsi-v-top-border = <0>;
		qcom,mdss-dsi-v-bottom-border = <0>;
		qcom,mdss-dsi-bpp = <24>;
		qcom,mdss-dsi-color-order = "rgb_swap_rgb";
		qcom,mdss-dsi-underflow-color = <0xff>;
		qcom,mdss-dsi-border-color = <0>;
		qcom,mdss-dsi-h-sync-pulse = <0>;
		qcom,mdss-dsi-traffic-mode = "non_burst_sync_event";
		qcom,mdss-dsi-lane-map = "lane_map_0123";
		qcom,mdss-dsi-bllp-eof-power-mode;
		qcom,mdss-dsi-bllp-power-mode;
		qcom,mdss-dsi-tx-eot-append;
		qcom,mdss-dsi-lane-0-state;
		qcom,mdss-dsi-lane-1-state;
		qcom,mdss-dsi-lane-2-state;
		qcom,mdss-dsi-lane-3-state;
		qcom,mdss-dsi-dma-trigger = "trigger_sw";
		qcom,mdss-dsi-mdp-trigger = "none";
		qcom,mdss-dsi-bl-inverted-dbv;
		qcom,mdss-dsi-reset-sequence = <1 10>, <0 10>, <1 10>;
		qcom,mdss-pan-physical-width-dimension = <71>;
		qcom,mdss-pan-physical-height-dimension = <156>;
		qcom,mdss-dsi-display-timings {
			timing@0 {
				qcom,mdss-dsi-panel-width = <720>;
				qcom,mdss-dsi-panel-height = <1570>;
				qcom,mdss-dsi-h-front-porch = <140>;
				qcom,mdss-dsi-h-back-porch = <64>;
				qcom,mdss-dsi-h-pulse-width = <4>;
				qcom,mdss-dsi-h-sync-skew = <0>;
				qcom,mdss-dsi-v-back-porch = <33>;
				qcom,mdss-dsi-v-front-porch = <180>;
				qcom,mdss-dsi-v-pulse-width = <4>;
				qcom,mdss-dsi-panel-framerate = <120>;
				qcom,mdss-dsi-on-command = [
					15 01 00 00 00 00 02 B0 00
					39 01 00 00 00 00 07 B8 02 4A 06 00 04 28
					39 01 00 00 00 00 07 B9 02 4A 18 00 09 42
					39 01 00 00 00 00 07 BA 02 00 00 00 00 00
					39 01 00 00 00 00 19 CE 1E 40 60 88 92 98 A4 AD B8 C0 C1 C2 C3 C4 C5 C6 C7 07 0F 00 00 00 04 8C
					15 01 00 00 00 00 02 D6 00
					15 01 00 00 00 00 02 53 2C
					15 01 00 00 00 00 02 55 01
					15 01 00 00 00 00 02 35 00
					39 01 00 00 00 00 03 51 00 00
					15 01 00 00 00 00 02 B0 03
					15 00 00 00 78 00 02 11 00
					15 00 00 00 14 00 02 29 00
				];
				qcom,mdss-dsi-backlight-gamma-enter-command = [
					15 01 00 00 00 00 02 B0 00
					39 01 00 00 00 00 4D C7 02 AF 02 B6 02 C3 02 D0 02 E8 02 CD 02 70 02 2E 01 FA 01 E7 01 D7 01 D3 01 D8 01 C9 01 CC 02 4E 02 79 02 A1 02 B4 02 AF 02 B6 02 C3 02 D0 02 E8 02 CD 02 70 02 2E 01 FA 01 E7 01 D7 01 D3 01 D8 01 C9 01 CC 02 4E 02 88 02 D9 02 FC
				];
				qcom,mdss-dsi-backlight-gamma-exit-command = [
					15 01 00 00 00 00 02 B0 00
					39 01 00 00 00 00 4D C7 00 6C 00 A0 00 BD 00 F8 01 55 01 7D 01 79 01 84 01 83 01 8D 01 94 01 9C 01 AA 01 A0 01 B2 02 3C 02 6C 02 8E 02 93 00 24 00 45 00 BB 00 F8 01 55 01 7D 01 79 01 84 01 83 01 8D 01 94 01 9C 01 AA 01 A0 01 B2 02 3C 02 6C 02 93 02 DB
				];
				qcom,mdss-dsi-off-command = [
					15 01 00 00 14 00 02 28 00
					15 01 00 00 78 00 02 10 00
				];
				qcom,mdss-dsi-cabc-mode1-command = [
					15 01 00 00 00 00 02 55 01
				];
				qcom,mdss-dsi-cabc-mode2-command = [
					15 01 00 00 00 00 02 55 02
				];
				qcom,mdss-dsi-cabc-off-command = [
					15 01 00 00 00 00 02 55 03
				];
				qcom,mdss-dsi-on-command-state = "dsi_lp_mode";
				qcom,mdss-dsi-backlight-gamma-enter-command-state = "dsi_hs_mode";
				qcom,mdss-dsi-backlight-gamma-exit-command-state = "dsi_hs_mode";
				qcom,mdss-dsi-off-command-state = "dsi_lp_mode";
				qcom,mdss-dsi-cabc-mode1-command-state = "dsi_hs_mode";
				qcom,mdss-dsi-cabc-mode2-command-state = "dsi_hs_mode";
				qcom,mdss-dsi-cabc-mode3-command-state = "dsi_hs_mode";
				qcom,mdss-dsi-cabc-off-command-state = "dsi_hs_mode";
			};
		};
	};
};
&dsi_panel_AC349_P_D_A0018_video {
	qcom,panel-supply-entries = <&dsi_panel_pwr_supply_no_labibb>;
	qcom,mdss-dsi-bl-pmic-control-type = "bl_ctrl_dcs";
	qcom,bl-update-flag = "delay_until_first_frame";
	qcom,mdss-dsi-bl-inverted-dbv;
	qcom,mdss-dsi-bl-min-level = <8>;
	qcom,mdss-dsi-bl-max-level = <4095>;
	qcom,mdss-brightness-max-level = <4095>;
	oplus,dsi-bl-normal-max-level = <3276>;
	oplus,dsi-brightness-normal-max-level = <3276>;
	oplus,dsi-brightness-default-level = <526>;
	qcom,platform-te-gpio = <&tlmm 81 0>;
	qcom,platform-reset-gpio = <&tlmm 82 0>;
	qcom,platform-panel-P5V-gpio = <&tlmm 105 0>;
	qcom,platform-panel-N5V-gpio = <&tlmm 54 0>;
	oplus,mdss-dsi-vspn-voltage = <5500>;
	oplus,mdss-dsi-gamma-switch-enabled;
	qcom,dsi-supported-dfps-list = <120 90 60>;
	qcom,mdss-dsi-pan-enable-dynamic-fps;
	qcom,mdss-dsi-pan-fps-update = "dfps_immediate_porch_mode_vfp";
	qcom,mdss-dsi-min-refresh-rate = <60>;
	qcom,mdss-dsi-max-refresh-rate = <120>;
	oppo,dfps-idle-off;
	qcom,esd-check-enabled;
	qcom,mdss-dsi-panel-status-check-mode = "reg_read";
	qcom,mdss-dsi-panel-status-command = [06 01 00 01 00 00 01 0A];
	qcom,mdss-dsi-panel-status-command-state = "dsi_lp_mode";
	qcom,mdss-dsi-panel-status-value = <0x9C>;
	qcom,mdss-dsi-panel-on-check-value = <0x9C>;
	qcom,mdss-dsi-panel-status-read-length = <1>;
	/* MIPI dyn clk */
	//qcom,dsi-dyn-clk-enable;
	qcom,dsi-select-clocks = "pll_byte_clk0", "pll_dsi_clk0";
	qcom,mdss-dsi-display-timings {
		timing@0 {
			qcom,mdss-dsi-panel-phy-timings = [00 27 0A 0A 1B 19 0A 0B 0A 02 04 00 20 0F];
			qcom,display-topology = <1 0 1>;
			qcom,default-topology-index = <0>;
			qcom,dsi-dyn-clk-list = <1194001920 1198976928>;
		};
	};
};
