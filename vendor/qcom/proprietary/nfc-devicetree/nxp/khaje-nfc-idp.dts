/dts-v1/;
/plugin/;

#include "khaje-nfc-common.dtsi"
/ {
	model = "Qualcomm Technologies, Inc. Khaje IDP";
	compatible = "qcom,khaje-idp";
	qcom,msm-id = <518 0x10000>, <586 0x10000>;
	qcom,board-id = <0x10022 0>;
};
