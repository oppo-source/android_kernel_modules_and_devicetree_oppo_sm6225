/dts-v1/;
/plugin/;

#include "bengal-nfc-common.dtsi"
/ {
	model = "Qualcomm Technologies, Inc. BENGAL IDP";
	compatible = "qcom,bengal-idp", "qcom,bengal";
	qcom,msm-id = <417 0x10000>, <444 0x10000>;
	qcom,board-id = <34 0>, <34 1>;
};
