/dts-v1/;
/plugin/;

#include "bengal-nfc-common.dtsi"
/ {
	model = "Qualcomm Technologies, Inc. Bengal RUMI";
	compatible = "qcom,bengal-rumi", "qcom,bengal";
	qcom,msm-id = <417 0x10000>;
	qcom,board-id = <15 0>;
};
