/dts-v1/;
/plugin/;

#include "khaje-nfc-common.dtsi"
/ {
	model = "Qualcomm Technologies, Inc. Khaje QRD";
	compatible = "qcom,khaje-qrd", "qcom,khaje";
	qcom,msm-id = <518 0x10000>, <585 0x10000>;
	qcom,board-id = <0x1000B 0>;
};
