/dts-v1/;
/plugin/;

#include "bengal-camera-sensor-qrd.dtsi"
/ {
	model = "Qualcomm Technologies, Inc. Bengal QRD";
	compatible = "qcom,bengal-qrd", "qcom,bengal", "qcom,qrd";
	qcom,msm-id = <417 0x10000>, <444 0x10000>;
	qcom,board-id = <0x1000B 0>;
};
