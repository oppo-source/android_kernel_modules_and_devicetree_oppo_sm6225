/dts-v1/;
/plugin/;

#include "bengal-camera-sensor-idp.dtsi"
/ {
	model = "Qualcomm Technologies, Inc. Bengal  IDP";
	compatible = "qcom,bengal-idp", "qcom,bengal", "qcom,idp";
        qcom,msm-id = <417 0x10000>, <444 0x10000>;
	qcom,board-id = <34 0>, <34 1>;
	qcom,pmic-id = <0x2D 0x25 0x0 0x0>;
};
