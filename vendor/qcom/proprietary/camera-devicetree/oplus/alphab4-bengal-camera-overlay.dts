/dts-v1/;
/plugin/;

#include <dt-bindings/clock/qcom,gcc-sm6115.h>
#include <dt-bindings/interrupt-controller/arm-gic.h>
#include <dt-bindings/regulator/qcom,rpmh-regulator-levels.h>
#include <dt-bindings/msm-camera.h>
#include <dt-bindings/interconnect/qcom,bengal.h>

#include "regulator/aw37004.dtsi"
#include "../bengal-camera.dtsi"
#include "../khaje-camera-sensor-qrd.dtsi"
#include "camera/bengal-alphab4-camera-overlay.dtsi"

/ {
    model = "Qualcomm Technologies, Inc. BENGAL QRD nopmi overlay, Alpha-L4";
    oplus,dtsi_no = <24303 24302 24305 24308 24288>;
    oplus,project-id = <24303 24302 24305 24308 24288>;
};