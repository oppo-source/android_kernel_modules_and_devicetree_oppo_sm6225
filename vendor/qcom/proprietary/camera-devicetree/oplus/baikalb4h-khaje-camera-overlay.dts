/dts-v1/;
/plugin/;

#include <dt-bindings/clock/qcom,gcc-khaje.h>
#include <dt-bindings/interrupt-controller/arm-gic.h>
#include <dt-bindings/regulator/qcom,rpmh-regulator-levels.h>
#include <dt-bindings/msm-camera.h>
#include <dt-bindings/interconnect/qcom,bengal.h>

#include "regulator/aw37004.dtsi"
#include "../khaje-camera.dtsi"
#include "../khaje-camera-sensor-qrd-baikalb4hl.dtsi"
#include "../khaje-camera-sensor-nopmi.dtsi"
#include "camera/khaje-baikalb4h-camera-overlay.dtsi"

/ {
    model = "Qualcomm Technologies, Inc. KHAJE QRD nopmi overlay, Baikal-B4H";
    oplus,dtsi_no = <25250 25251 25252>;
    oplus,project-id = <25250 25251 25252>;
};
