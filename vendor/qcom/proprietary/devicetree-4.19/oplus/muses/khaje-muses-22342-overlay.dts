/dts-v1/;
/plugin/;

#include "../../qcom/khaje-qrd-nopmi-overlay.dts"
#include "khaje_overlay_common.dtsi"
#include "khaje_22342_overlay_common.dtsi"

#include "audio/khaje-muses-audio-overlay.dtsi"

/ {
    model = "Qualcomm Technologies, Inc. KHAJE QRD nopmi overlay, muses";
    oplus,dtsi_no = <22342>;
};

