&mdss_mdp {
	dsi_ili7807s_hlt_fhd_video: qcom,mdss_dsi_ili7807s_120hz_hlt_video {
		qcom,mdss-dsi-panel-name =
				"ili7807s hlt fhd video mode dsi panel";
		qcom,mdss-dsi-panel-type = "dsi_video_mode";
		qcom,dsi-ctrl-num = <0>;
		qcom,dsi-phy-num = <0>;
		qcom,mdss-dsi-virtual-channel-id = <0>;
		qcom,mdss-dsi-stream = <0>;
		qcom,mdss-dsi-h-left-border = <0>;
		qcom,mdss-dsi-h-right-border = <0>;
		qcom,mdss-dsi-v-top-border = <0>;
		qcom,mdss-dsi-v-bottom-border = <0>;
		qcom,mdss-dsi-bpp = <24>;
		qcom,mdss-dsi-color-order = "rgb_swap_rgb";
		qcom,mdss-dsi-underflow-color = <0xff>;
		qcom,mdss-dsi-border-color = <0>;
		qcom,mdss-dsi-h-sync-pulse = <0>;
		qcom,mdss-dsi-traffic-mode = "non_burst_sync_event";
		qcom,mdss-dsi-lane-map = "lane_map_0123";
		qcom,mdss-dsi-bllp-eof-power-mode;
		qcom,mdss-dsi-bllp-power-mode;
		qcom,ulps-enabled;
		qcom,suspend-ulps-enabled;
		qcom,mdss-dsi-tx-eot-append;
		qcom,mdss-dsi-lane-0-state;
		qcom,mdss-dsi-lane-1-state;
		qcom,mdss-dsi-lane-2-state;
		qcom,mdss-dsi-lane-3-state;
		qcom,mdss-dsi-dma-trigger = "trigger_sw";
		qcom,mdss-dsi-mdp-trigger = "none";
		qcom,mdss-dsi-lp11-init;
		qcom,mdss-dsi-bl-pmic-control-type = "bl_ctrl_dcs";
		qcom,mdss-dsi-bl-min-level = <1>;
		qcom,mdss-dsi-bl-normal-max-level = <3383>;
		qcom,mdss-dsi-bl-max-level = <4095>;
		qcom,mdss-brightness-normal-max-level = <3383>;
		qcom,mdss-brightness-max-level = <4095>;
		qcom,mdss-brightness-default-level = <400>;
		qcom,mdss-dsi-reset-sequence = <1 10>, <0 10>, <1 10>;
		qcom,mdss-pan-physical-width-dimension = <68>;
		qcom,mdss-pan-physical-height-dimension = <151>;
		oplus,mdss-dsi-vendor-name = "HLT_ILI7807S";
		oplus,mdss-dsi-manufacture = "HLT_ILI7807S";
		oplus,panel-cabc-soda;
		qcom,mdss-dsi-display-timings {
			timing@0 {
				qcom,mdss-dsi-video-mode;
				qcom,mdss-dsi-panel-width = <1080>;
				qcom,mdss-dsi-panel-height = <2412>;
				qcom,mdss-dsi-h-front-porch = <68>;
				qcom,mdss-dsi-h-back-porch = <72>;
				qcom,mdss-dsi-h-pulse-width = <12>;
				qcom,mdss-dsi-h-sync-skew = <0>;
				qcom,mdss-dsi-v-back-porch = <36>;
				qcom,mdss-dsi-v-front-porch = <40>;
				qcom,mdss-dsi-v-pulse-width = <4>;
				qcom,mdss-dsi-panel-framerate = <60>;
				qcom,mdss-dsi-on-command = [
					39 01 00 00 00 00 04 FF 78 07 06
					15 01 00 00 00 00 02 08 20

					39 01 00 00 00 00 04 FF 78 07 03
                    			15 01 00 00 00 00 02 81 14
					15 01 00 00 00 00 02 82 15
					15 01 00 00 00 00 02 83 20
					15 01 00 00 00 00 02 84 00

					39 01 00 00 00 00 04 FF 78 07 03
					15 01 00 00 00 00 02 88 CC  //black 80%
					15 01 00 00 00 00 02 89 E5  //gray 89.84%
                    			15 01 00 00 00 00 02 8A ED  //fruit 92.97%
					15 01 00 00 00 00 02 8B EF
                    			15 01 00 00 00 00 02 B3 E5  //desktop 89.84%
					15 01 00 00 00 00 02 AC FA  //bai 98%

					15 01 00 00 00 00 02 AD E0  //white 87.89%
					15 01 00 00 00 00 02 8C 9B  //black 60.94%
					15 01 00 00 00 00 02 8D A9
					15 01 00 00 00 00 02 8E AD
					15 01 00 00 00 00 02 8F AF
					15 01 00 00 00 00 02 90 B2  //gray 69.92%
					15 01 00 00 00 00 02 91 BC
					15 01 00 00 00 00 02 92 BD
					15 01 00 00 00 00 02 93 BA
					15 01 00 00 00 00 02 94 CA
					15 01 00 00 00 00 02 95 D5  //fruit 73%->83.6%
                    			15 01 00 00 00 00 02 B4 D9  //desktop 71%->85.2%

                    			15 01 00 00 00 00 02 AE D3  //white 82.81%
					15 01 00 00 00 00 02 96 70  //black 44.14%
					15 01 00 00 00 00 02 97 97
					15 01 00 00 00 00 02 98 99
					15 01 00 00 00 00 02 99 9F
					15 01 00 00 00 00 02 9A A3  //gray 64%
					15 01 00 00 00 00 02 9B A6
					15 01 00 00 00 00 02 9C A9
					15 01 00 00 00 00 02 9D AD
					15 01 00 00 00 00 02 9E C2
					15 01 00 00 00 00 02 9F CC  //fruit 67.97%->80%
                    			15 01 00 00 00 00 02 B5 D0  //desktop 64.84%->81%

                    			15 01 00 00 00 00 02 A0 C0
					15 01 00 00 00 00 02 A1 7E  //threshold
					15 01 00 00 00 00 02 A2 7E  //threshold higth light moving
					15 01 00 00 00 00 02 A7 E5  //Highlight PWM
					15 01 00 00 00 00 02 A8 E5  //Highlight PWM
					15 01 00 00 00 00 02 B6 00
					15 01 00 00 00 00 02 B7 D0
					15 01 00 00 00 00 02 B8 D0
					15 01 00 00 00 00 02 B1 66
					15 01 00 00 00 00 02 B2 66
					15 01 00 00 00 00 02 86 6C
                    			15 01 00 00 00 00 02 87 6C

					39 01 00 00 00 00 04 FF 78 07 06
					15 01 00 00 00 00 02 3E E2
					15 01 00 00 00 00 02 48 0F
					15 01 00 00 00 00 02 4D 80
					15 01 00 00 00 00 02 4E 40
					15 01 00 00 00 00 02 C7 05

					39 01 00 00 00 00 04 FF 78 07 00
					15 01 00 00 00 00 02 53 2C
					15 01 00 00 00 00 02 55 02
					15 01 00 00 00 00 02 35 00
					39 01 00 00 00 00 03 51 0F FF

                    			39 01 00 00 00 00 04 FF 78 07 00
					05 01 00 00 50 00 01 11
                    			39 01 00 00 00 00 04 FF 78 07 07
                    			15 01 00 00 00 00 02 29 80
					39 01 00 00 00 00 04 FF 78 07 02
					15 01 00 00 00 00 02 1B 02	// FR_sel:FPS/TP [00:120/180 ]
					39 01 00 00 00 00 04 FF 78 07 04
					15 01 00 00 00 00 02 BD 01	// GRAM Arbiter reset

					39 01 00 00 00 00 04 FF 78 07 00
					05 01 00 00 14 00 01 29
				];
				qcom,mdss-dsi-off-command = [
					39 01 00 00 00 00 04 FF 78 07 00
					39 01 00 00 14 00 02 28 00
					39 01 00 00 78 00 02 10 00
				];
                		//qcom,compression-mode = "dsc";
				//qcom,mdss-dsc-slice-height = <12>;
				//qcom,mdss-dsc-slice-width = <540>;
				//qcom,mdss-dsc-slice-per-pkt = <1>;
				//qcom,mdss-dsc-bit-per-component = <8>;
				//qcom,mdss-dsc-bit-per-pixel = <8>;
				//qcom,mdss-dsc-block-prediction-enable;
				qcom,mdss-dsi-on-command-state = "dsi_lp_mode";
				qcom,mdss-dsi-off-command-state = "dsi_lp_mode";
			};
		};
	};
};


&dsi_ili7807s_hlt_fhd_video {
	qcom,panel-supply-entries = <&dsi_panel_pwr_supply_no_labibb>;
	qcom,mdss-dsi-bl-pmic-control-type = "bl_ctrl_dcs";
	qcom,bl-pmic-pwm-period-usecs = <100>;
	qcom,mdss-dsi-bl-min-level = <1>;
	qcom,mdss-dsi-bl-normal-max-level = <3562>;
	qcom,mdss-dsi-bl-max-level = <4095>;
	qcom,mdss-brightness-normal-max-level = <3562>;
	qcom,mdss-brightness-max-level = <4095>;
	qcom,mdss-brightness-default-level = <400>;
	qcom,platform-te-gpio = <&tlmm 81 0>;
	qcom,platform-reset-gpio = <&tlmm 82 0>;
	qcom,platform-panel-vddi-gpio = <&tlmm 103 0>;
	qcom,platform-panel-P5V-gpio = <&tlmm 43 0>;
	qcom,platform-panel-N5V-gpio = <&tlmm 54 0>;

    	//qcom,compression-mode = "dsc";
    	//qcom,mdss-dsc-slice-height = <12>;
    	//qcom,mdss-dsc-slice-width = <540>;
    	//qcom,mdss-dsc-slice-per-pkt = <1>;
    	//qcom,mdss-dsc-bit-per-component = <8>;
    	//qcom,mdss-dsc-bit-per-pixel = <8>;
    	//qcom,mdss-dsc-block-prediction-enable;
	qcom,mdss-dsi-t-clk-post = <0x0F>;
	qcom,mdss-dsi-t-clk-pre = <0x1E>;

	//qcom,dsi-supported-dfps-list = <60 90>;
	//qcom,mdss-dsi-pan-enable-dynamic-fps;
	//qcom,mdss-dsi-pan-fps-update =
	//"dfps_immediate_porch_mode_vfp";
	//qcom,mdss-dsi-min-refresh-rate = <60>;
	//qcom,mdss-dsi-max-refresh-rate = <90>;
	//oplus,dfps-idle-off;
	//qcom,esd-check-enabled;
	qcom,mdss-dsi-panel-status-check-mode = "reg_read";
	qcom,mdss-dsi-panel-status-command = [06 01 00 01 00 00 01 0a];
	qcom,mdss-dsi-panel-status-command-state = "dsi_lp_mode";
	qcom,mdss-dsi-panel-status-value = <0x9c>;
	qcom,mdss-dsi-panel-on-check-value = <0x9c>;
	qcom,mdss-dsi-panel-status-read-length = <1>;
	qcom,dsi-select-clocks = "mux_byte_clk0", "mux_pixel_clk0";

	qcom,mdss-dsi-display-timings {
		timing@0{
			qcom,mdss-dsi-panel-phy-timings =[00 12 04 04 12 1E 04
					04 03 02 04 0F 09 00];

			qcom,display-topology = <1 0 1>;
			qcom,default-topology-index = <0>;
		};
	};
};
