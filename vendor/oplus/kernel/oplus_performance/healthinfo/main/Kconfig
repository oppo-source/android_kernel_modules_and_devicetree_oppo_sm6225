## vendor/oplus/kernel/oplus_performance/healthinfo/main/Kconfig
```kconfig
#ifdef OPLUS_FEATURE_HEALTHINFO
#//wenbin.liu@PSW.Kernel.MM, 2018/05/23, Add for Healthinfo monitor
config OPLUS_HEALTHINFO
bool "config healthinfo"
help
    define this config to init  healthinfo.
config MMAP_LOCK_OPT
	bool "config mmap lock opt boos"
	default n
	help
	  reduce sleep time in mmap lock
#endif /* OPLUS_FEATURE_HEALTHINFO */
```

## vendor/oplus/kernel/oplus_performance/sched_assist/Kconfig
```kconfig
config OPLUS_FEATURE_SCHED_ASSIST
	tristate "sched_assist"
	default n
	help
	  turning sched for ui, render and so on to improve UX
config OPLUS_FEATURE_SCHED_SPREAD
        bool "sched_spread"
        default n
        help
          This is the uifirst 5.0 feature, which will spread tasks,
          kick runnable time from task demand and adjust bg's time slice.

config OPLUS_UX_IM_FLAG
        bool "config ux im_flag"
        default n
        help
          export im_flag proc node for mark thread.

config OPLUS_CPU_AUDIO_PERF
	tristate "boost audio task in scheduler"
	default n
	depends on OPLUS_UX_IM_FLAG
	help
	   Choose this option to enable scheduler boost for audio task.
```

## vendor/oplus/kernel/touchpanel/oplus_touchscreen/Novatek/NT36523_noflash/Kconfig
```kconfig
#ifdef OPLUS_FEATURE_TP_BASIC
#Added by Longfei.Wang@Bsp.group.Tp for nova nt36525_noflash ic driver

config TOUCHPANEL_NOVA_NT36523_NOFLASH
	bool "TP nova nt36523—noflash IC enable or not for OPPO"
	---help---
	say Y to enable driver for Touchpanel useing nova nt36523-noflash
#endif
```

## vendor/qcom/opensource/mm-drivers/hw_fence/Kconfig
```kconfig
# SPDX-License-Identifier: GPL-2.0-only

config QTI_HW_FENCE
	bool "HW Fence"
	help
	  Enable the hw_fence module
```

## vendor/qcom/opensource/mm-drivers/msm_ext_display/Kconfig
```kconfig
# SPDX-License-Identifier: GPL-2.0-only

config MSM_EXT_DISPLAY
	bool "Enable msm_ext_display"
	help
	  Enable msm_ext_display driver
```
