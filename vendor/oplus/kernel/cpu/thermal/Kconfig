## vendor/oplus/kernel/cpu/thermal/Kconfig
```kconfig
#
# Generic thermal sysfs drivers configuration
#

config HORAE_THERMAL_SHELL
	  tristate "Horae shell temp driver"
	  default y
	  help
	    Provide three thermal zones(front, frame and back) to get real shell temp.

config OPLUS_IPA_THERMAL
	  tristate "oplus ipa thermal sensor driver"
	  depends on HORAE_THERMAL_SHELL
	  default n
	  help
	    the driver of oplus virtual ipa sensor

config HORAE_FLASH_LED_THERMAL
	  tristate "horae flash led thermal driver"
	  default m
	  help
	    Provide flash_led thermal zone and ntc switch function
```
